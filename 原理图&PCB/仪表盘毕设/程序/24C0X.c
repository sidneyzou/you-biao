/**********************外扩24C0X系列EEPROM函数文件*********************************
*  晶振:11.0592MHZ
******************************************************************/

/**********************包含文件*******************/
#include "24C0X.h"

/*********************************全局变初始化***********************************/  


/******************************************************************************/
/* 函数名称  : EEPROM_Init                                                    */
/* 函数描述  : 外扩EEPROM初始化                                               */
/* 输入参数  : Void                                                           */
/* 参数描述  : 无                                                             */
/* 返回值    : 无                                                             */
/******************************************************************************/	
void EEPROM_Init(void)  //24c0X初始化子程序  I2C总线传输
{
	eeprom_scl = 1;  //拉高控制线
	EEPROM_Nop();  
	eeprom_sda = 1;  //拉高数据线
	EEPROM_Nop();
}
/******************************************************************************/
/* 函数名称  : EEPROM_Start                                                   */
/* 函数描述  : 外扩EEPROM I2C启动                                             */
/* 输入参数  : Void                                                           */
/* 参数描述  : 无                                                             */
/* 返回值    : 无                                                             */
/******************************************************************************/	
void EEPROM_Start(void)        //启动I2C总线
{
	eeprom_sda = 1;  //拉高数据线
	EEPROM_Nop();
	eeprom_scl = 1;  //拉高控制线
	EEPROM_Nop();
	eeprom_sda = 0;  //拉低数据线
	EEPROM_Nop();
	eeprom_scl = 0;  //拉低控制线
	EEPROM_Nop();
}
/******************************************************************************/
/* 函数名称  : EEPROM_Stop                                                    */
/* 函数描述  : 停止I2C总线                                                    */
/* 输入参数  : Void                                                           */
/* 参数描述  : 无                                                             */
/* 返回值    : 无                                                             */
/******************************************************************************/	
void EEPROM_Stop(void)         //停止I2C总线
{
	eeprom_sda = 0;   //拉低数据线
	EEPROM_Nop();
	eeprom_scl = 1;   //拉高控制线
	EEPROM_Nop();
	eeprom_sda = 1;   //拉低数据线
	EEPROM_Nop();
}
/******************************************************************************/
/* 函数名称  : EEPROM_Write_Byte                                              */
/* 函数描述  : KEY扫描                                                        */
/* 输入参数  : Void                                                           */
/* 参数描述  : 无                                                             */
/* 返回值    : 无                                                             */
/******************************************************************************/	
void EEPROM_Write_Byte(uchar dat)  //写一个字节
{
	 uchar i,temp;
   temp = dat;
   for (i = 0; i < 8; i++)
   {
	   temp = temp<<1;
	   eeprom_scl = 0;    //拉低控制线
	   EEPROM_Nop();
	   eeprom_sda = CY;		//temp左移时，移出的值放入了CY中
	   EEPROM_Nop();
	   eeprom_scl = 1;		//待sda线上的数据稳定后，将scl拉高
	   EEPROM_Nop();
   }
   eeprom_scl = 0;    //拉低控制线
   EEPROM_Nop();
   eeprom_sda = 1;   //拉高数据线
   EEPROM_Nop();
}
/******************************************************************************/
/* 函数名称  : EEPROM_Read_Byte                                               */
/* 函数描述  : KEY扫描                                                        */
/* 输入参数  : Void                                                           */
/* 参数描述  : 无                                                             */
/* 返回值    : 无                                                             */
/******************************************************************************/	
uchar EEPROM_Read_Byte(void)   //读一个字节
{
   uchar i,j,dat = 0;
   eeprom_scl = 0; EEPROM_Nop(); eeprom_sda = 1;
   for (i=0;i<8;i++)
   {  
		EEPROM_Nop(); eeprom_scl = 1; EEPROM_Nop();
      	if(eeprom_sda == 1) 
					j = 1;
      	else
					j = 0;
      	dat = (dat << 1) | j;
	  	eeprom_scl = 0;
	}
   	EEPROM_Nop();
	return (dat);
}
/******************************************************************************/
/* 函数名称  : EEPROM_Clock                                                   */
/* 函数描述  : EEPROM时钟时序                                                 */
/* 输入参数  : Void                                                           */
/* 参数描述  : 无                                                             */
/* 返回值    : 无                                                             */
/******************************************************************************/	
void EEPROM_Clock(void)         //I2C总线时钟
{
   uchar i = 0;
   eeprom_scl = 1;                     //拉高控制线
   EEPROM_Nop();
   while((eeprom_sda == 1) && (i < 255))  //判定数据是否送达或者收到
   	  i++;
   eeprom_scl = 0;                   //拉低控制线
   EEPROM_Nop();
}
/******************************************************************************/
/* 函数名称  : EEPROM_Read                                                    */
/* 函数描述  : EEPROM读取数据时序                                             */
/* 输入参数  : uchar add                                                      */
/* 参数描述  : 需要读取的地址                                                 */
/* 返回值    : 无                                                             */
/******************************************************************************/	
uchar EEPROM_Read(uchar add)
{
   uchar dat;
   EEPROM_Start();          //开始时序
   EEPROM_Write_Byte(0xa0); //写入控制符
   EEPROM_Clock();          //时钟时序
	
   EEPROM_Write_Byte(add);  //写入地址
   EEPROM_Clock();          //时钟时序
	
   EEPROM_Start();          //开始时序
   EEPROM_Write_Byte(0xa1); //写入控制符
   EEPROM_Clock();          //时钟时序
	
   dat = EEPROM_Read_Byte();//读取数据
   EEPROM_Stop();           //关闭时序
   EEPROM_Delay(100);      //延时等待
   return(dat);
}
/******************************************************************************/
/* 函数名称  : EEPROM_Write                                                   */
/* 函数描述  : EEPROM写入数据时序                                             */
/* 输入参数  : unchar add, uchar dat                                          */
/* 参数描述  : 写入的地址，写入的数据                                         */
/* 返回值    : 无                                                             */
/******************************************************************************/	
void EEPROM_Write(uchar add,uchar dat)
{
   EEPROM_Start();          //开始时序
   EEPROM_Write_Byte(0xa0); //写入控制符
   EEPROM_Clock();          //时钟时序
	
   EEPROM_Write_Byte(add);  //写入地址
   EEPROM_Clock();          //时钟时序
	
   EEPROM_Write_Byte(dat);  //写入数据
   EEPROM_Clock();          //时钟时序
	
   EEPROM_Stop();           //关闭时序
   EEPROM_Delay(5000);     //这个延时一定要足够长，否则会出错。因为24c02在从sda上取得数据后，还需要一定时间的烧录过程。
}


/******************************************************************************/
/* 函数名称  : EEPROM_Nop                                                     */
/* 函数描述  : 延时程序                                                       */
/* 输入参数  : Void                                                           */
/* 参数描述  : 无                                                             */
/* 返回值    : 无                                                             */
/******************************************************************************/	
void EEPROM_Nop(void)
{
	_nop_();
	_nop_();
}

/******************************************************************************/
/* 函数名称  : EEPROM_Delay                                                   */
/* 函数描述  : 延时程序                                                       */
/* 输入参数  : Void                                                           */
/* 参数描述  : 无                                                             */
/* 返回值    : 无                                                             */
/******************************************************************************/	
void EEPROM_Delay(uint m)
{	
	uint n;
  for(n = 0; n < m; n++);
}
